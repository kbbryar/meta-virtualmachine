## conf/layer.conf
```bitbake
# We have a conf and classes directory, add to BBPATH
BBPATH .= ":${LAYERDIR}"

# We have recipes-* directories, add to BBFILES
BBFILES += "${LAYERDIR}/recipes-*/*/*/*.bb \
            ${LAYERDIR}/recipes-*/*/*/*.bbappend"

BBFILE_COLLECTIONS += "meta-virtualmachine"
BBFILE_PATTERN_meta-virtualmachine = "^${LAYERDIR}/"
BBFILE_PRIORITY_meta-virtualmachine = "6"

LAYERDEPENDS_meta-virtualmachine = "core"
LAYERSERIES_COMPAT_meta-virtualmachine = "gatesgarth"
```
